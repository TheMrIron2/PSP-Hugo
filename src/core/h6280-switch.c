lab_0xf0: beq(); goto lab_end;
lab_0xc5: cmp_zp(); goto lab_end;
lab_0x53: tam(); goto lab_end;
lab_0xa5: lda_zp(); goto lab_end;
lab_0x8d: sta_abs(); goto lab_end;
lab_0xd0: bne(); goto lab_end;
lab_0x68: pla(); goto lab_end;
lab_0x48: pha(); goto lab_end;
lab_0x1a: inc_a(); goto lab_end;
lab_0x0: brek(); goto lab_end;
lab_0x1: ora_zpindx(); goto lab_end;
lab_0x2: sxy(); goto lab_end;
lab_0x3: st0(); goto lab_end;
lab_0x4: tsb_zp(); goto lab_end;
lab_0x5: ora_zp(); goto lab_end;
lab_0x6: asl_zp(); goto lab_end;
lab_0x7: rmb0(); goto lab_end;
lab_0x8: php(); goto lab_end;
lab_0x9: ora_imm(); goto lab_end;
lab_0xa: asl_a(); goto lab_end;
lab_0xb: handle_bp0(); goto lab_end;
lab_0xc: tsb_abs(); goto lab_end;
lab_0xd: ora_abs(); goto lab_end;
lab_0xe: asl_abs(); goto lab_end;
lab_0xf: bbr0(); goto lab_end;
lab_0x10: bpl(); goto lab_end;
lab_0x11: ora_zpindy(); goto lab_end;
lab_0x12: ora_zpind(); goto lab_end;
lab_0x13: st1(); goto lab_end;
lab_0x14: trb_zp(); goto lab_end;
lab_0x15: ora_zpx(); goto lab_end;
lab_0x16: asl_zpx(); goto lab_end;
lab_0x17: rmb1(); goto lab_end;
lab_0x18: clc(); goto lab_end;
lab_0x19: ora_absy(); goto lab_end;
lab_0x1b: handle_bp1(); goto lab_end;
lab_0x1c: trb_abs(); goto lab_end;
lab_0x1d: ora_absx(); goto lab_end;
lab_0x1e: asl_absx(); goto lab_end;
lab_0x1f: bbr1(); goto lab_end;
lab_0x20: jsr(); goto lab_end;
lab_0x21: and_zpindx(); goto lab_end;
lab_0x22: sax(); goto lab_end;
lab_0x23: st2(); goto lab_end;
lab_0x24: bit_zp(); goto lab_end;
lab_0x25: and_zp(); goto lab_end;
lab_0x26: rol_zp(); goto lab_end;
lab_0x27: rmb2(); goto lab_end;
lab_0x28: plp(); goto lab_end;
lab_0x29: and_imm(); goto lab_end;
lab_0x2a: rol_a(); goto lab_end;
lab_0x2b: handle_bp2(); goto lab_end;
lab_0x2c: bit_abs(); goto lab_end;
lab_0x2d: and_abs(); goto lab_end;
lab_0x2e: rol_abs(); goto lab_end;
lab_0x2f: bbr2(); goto lab_end;
lab_0x30: bmi(); goto lab_end;
lab_0x31: and_zpindy(); goto lab_end;
lab_0x32: and_zpind(); goto lab_end;
lab_0x33: halt(); goto lab_end;
lab_0x34: bit_zpx(); goto lab_end;
lab_0x35: and_zpx(); goto lab_end;
lab_0x36: rol_zpx(); goto lab_end;
lab_0x37: rmb3(); goto lab_end;
lab_0x38: sec(); goto lab_end;
lab_0x39: and_absy(); goto lab_end;
lab_0x3a: dec_a(); goto lab_end;
lab_0x3b: handle_bp3(); goto lab_end;
lab_0x3c: bit_absx(); goto lab_end;
lab_0x3d: and_absx(); goto lab_end;
lab_0x3e: rol_absx(); goto lab_end;
lab_0x3f: bbr3(); goto lab_end;
lab_0x40: rti(); goto lab_end;
lab_0x41: eor_zpindx(); goto lab_end;
lab_0x42: say(); goto lab_end;
lab_0x43: tma(); goto lab_end;
lab_0x44: bsr(); goto lab_end;
lab_0x45: eor_zp(); goto lab_end;
lab_0x46: lsr_zp(); goto lab_end;
lab_0x47: rmb4(); goto lab_end;
lab_0x49: eor_imm(); goto lab_end;
lab_0x4a: lsr_a(); goto lab_end;
lab_0x4b: handle_bp4(); goto lab_end;
lab_0x4c: jmp(); goto lab_end;
lab_0x4d: eor_abs(); goto lab_end;
lab_0x4e: lsr_abs(); goto lab_end;
lab_0x4f: bbr4(); goto lab_end;
lab_0x50: bvc(); goto lab_end;
lab_0x51: eor_zpindy(); goto lab_end;
lab_0x52: eor_zpind(); goto lab_end;
lab_0x54: nop(); goto lab_end;
lab_0x55: eor_zpx(); goto lab_end;
lab_0x56: lsr_zpx(); goto lab_end;
lab_0x57: rmb5(); goto lab_end;
lab_0x58: cli(); goto lab_end;
lab_0x59: eor_absy(); goto lab_end;
lab_0x5a: phy(); goto lab_end;
lab_0x5b: handle_bp5(); goto lab_end;
lab_0x5c: halt(); goto lab_end;
lab_0x5d: eor_absx(); goto lab_end;
lab_0x5e: lsr_absx(); goto lab_end;
lab_0x5f: bbr5(); goto lab_end;
lab_0x60: rts(); goto lab_end;
lab_0x61: adc_zpindx(); goto lab_end;
lab_0x62: cla(); goto lab_end;
lab_0x63: halt(); goto lab_end;
lab_0x64: stz_zp(); goto lab_end;
lab_0x65: adc_zp(); goto lab_end;
lab_0x66: ror_zp(); goto lab_end;
lab_0x67: rmb6(); goto lab_end;
lab_0x69: adc_imm(); goto lab_end;
lab_0x6a: ror_a(); goto lab_end;
lab_0x6b: handle_bp6(); goto lab_end;
lab_0x6c: jmp_absind(); goto lab_end;
lab_0x6d: adc_abs(); goto lab_end;
lab_0x6e: ror_abs(); goto lab_end;
lab_0x6f: bbr6(); goto lab_end;
lab_0x70: bvs(); goto lab_end;
lab_0x71: adc_zpindy(); goto lab_end;
lab_0x72: adc_zpind(); goto lab_end;
lab_0x73: tii(); goto lab_end;
lab_0x74: stz_zpx(); goto lab_end;
lab_0x75: adc_zpx(); goto lab_end;
lab_0x76: ror_zpx(); goto lab_end;
lab_0x77: rmb7(); goto lab_end;
lab_0x78: sei(); goto lab_end;
lab_0x79: adc_absy(); goto lab_end;
lab_0x7a: ply(); goto lab_end;
lab_0x7b: handle_bp7(); goto lab_end;
lab_0x7c: jmp_absindx(); goto lab_end;
lab_0x7d: adc_absx(); goto lab_end;
lab_0x7e: ror_absx(); goto lab_end;
lab_0x7f: bbr7(); goto lab_end;
lab_0x80: bra(); goto lab_end;
lab_0x81: sta_zpindx(); goto lab_end;
lab_0x82: clx(); goto lab_end;
lab_0x83: tstins_zp(); goto lab_end;
lab_0x84: sty_zp(); goto lab_end;
lab_0x85: sta_zp(); goto lab_end;
lab_0x86: stx_zp(); goto lab_end;
lab_0x87: smb0(); goto lab_end;
lab_0x88: dey(); goto lab_end;
lab_0x89: bit_imm(); goto lab_end;
lab_0x8a: txa(); goto lab_end;
lab_0x8b: handle_bp8(); goto lab_end;
lab_0x8c: sty_abs(); goto lab_end;
lab_0x8e: stx_abs(); goto lab_end;
lab_0x8f: bbs0(); goto lab_end;
lab_0x90: bcc(); goto lab_end;
lab_0x91: sta_zpindy(); goto lab_end;
lab_0x92: sta_zpind(); goto lab_end;
lab_0x93: tstins_abs(); goto lab_end;
lab_0x94: sty_zpx(); goto lab_end;
lab_0x95: sta_zpx(); goto lab_end;
lab_0x96: stx_zpy(); goto lab_end;
lab_0x97: smb1(); goto lab_end;
lab_0x98: tya(); goto lab_end;
lab_0x99: sta_absy(); goto lab_end;
lab_0x9a: txs(); goto lab_end;
lab_0x9b: handle_bp9(); goto lab_end;
lab_0x9c: stz_abs(); goto lab_end;
lab_0x9d: sta_absx(); goto lab_end;
lab_0x9e: stz_absx(); goto lab_end;
lab_0x9f: bbs1(); goto lab_end;
lab_0xa0: ldy_imm(); goto lab_end;
lab_0xa1: lda_zpindx(); goto lab_end;
lab_0xa2: ldx_imm(); goto lab_end;
lab_0xa3: tstins_zpx(); goto lab_end;
lab_0xa4: ldy_zp(); goto lab_end;
lab_0xa6: ldx_zp(); goto lab_end;
lab_0xa7: smb2(); goto lab_end;
lab_0xa8: tay(); goto lab_end;
lab_0xa9: lda_imm(); goto lab_end;
lab_0xaa: tax(); goto lab_end;
lab_0xab: handle_bp10(); goto lab_end;
lab_0xac: ldy_abs(); goto lab_end;
lab_0xad: lda_abs(); goto lab_end;
lab_0xae: ldx_abs(); goto lab_end;
lab_0xaf: bbs2(); goto lab_end;
lab_0xb0: bcs(); goto lab_end;
lab_0xb1: lda_zpindy(); goto lab_end;
lab_0xb2: lda_zpind(); goto lab_end;
lab_0xb3: tstins_absx(); goto lab_end;
lab_0xb4: ldy_zpx(); goto lab_end;
lab_0xb5: lda_zpx(); goto lab_end;
lab_0xb6: ldx_zpy(); goto lab_end;
lab_0xb7: smb3(); goto lab_end;
lab_0xb8: clv(); goto lab_end;
lab_0xb9: lda_absy(); goto lab_end;
lab_0xba: tsx(); goto lab_end;
lab_0xbb: handle_bp11(); goto lab_end;
lab_0xbc: ldy_absx(); goto lab_end;
lab_0xbd: lda_absx(); goto lab_end;
lab_0xbe: ldx_absy(); goto lab_end;
lab_0xbf: bbs3(); goto lab_end;
lab_0xc0: cpy_imm(); goto lab_end;
lab_0xc1: cmp_zpindx(); goto lab_end;
lab_0xc2: cly(); goto lab_end;
lab_0xc3: tdd(); goto lab_end;
lab_0xc4: cpy_zp(); goto lab_end;
lab_0xc6: dec_zp(); goto lab_end;
lab_0xc7: smb4(); goto lab_end;
lab_0xc8: iny(); goto lab_end;
lab_0xc9: cmp_imm(); goto lab_end;
lab_0xca: dex(); goto lab_end;
lab_0xcb: handle_bp12(); goto lab_end;
lab_0xcc: cpy_abs(); goto lab_end;
lab_0xcd: cmp_abs(); goto lab_end;
lab_0xce: dec_abs(); goto lab_end;
lab_0xcf: bbs4(); goto lab_end;
lab_0xd1: cmp_zpindy(); goto lab_end;
lab_0xd2: cmp_zpind(); goto lab_end;
lab_0xd3: tin(); goto lab_end;
lab_0xd4: nop(); goto lab_end;
lab_0xd5: cmp_zpx(); goto lab_end;
lab_0xd6: dec_zpx(); goto lab_end;
lab_0xd7: smb5(); goto lab_end;
lab_0xd8: cld(); goto lab_end;
lab_0xd9: cmp_absy(); goto lab_end;
lab_0xda: phx(); goto lab_end;
lab_0xdb: handle_bp13(); goto lab_end;
lab_0xdc: halt(); goto lab_end;
lab_0xdd: cmp_absx(); goto lab_end;
lab_0xde: dec_absx(); goto lab_end;
lab_0xdf: bbs5(); goto lab_end;
lab_0xe0: cpx_imm(); goto lab_end;
lab_0xe1: sbc_zpindx(); goto lab_end;
lab_0xe2: halt(); goto lab_end;
lab_0xe3: tia(); goto lab_end;
lab_0xe4: cpx_zp(); goto lab_end;
lab_0xe5: sbc_zp(); goto lab_end;
lab_0xe6: inc_zp(); goto lab_end;
lab_0xe7: smb6(); goto lab_end;
lab_0xe8: inx(); goto lab_end;
lab_0xe9: sbc_imm(); goto lab_end;
lab_0xea: nop(); goto lab_end;
lab_0xeb: handle_bp14(); goto lab_end;
lab_0xec: cpx_abs(); goto lab_end;
lab_0xed: sbc_abs(); goto lab_end;
lab_0xee: inc_abs(); goto lab_end;
lab_0xef: bbs6(); goto lab_end;
lab_0xf1: sbc_zpindy(); goto lab_end;
lab_0xf2: sbc_zpind(); goto lab_end;
lab_0xf3: tai(); goto lab_end;
lab_0xf4: set(); goto lab_end;
lab_0xf5: sbc_zpx(); goto lab_end;
lab_0xf6: inc_zpx(); goto lab_end;
lab_0xf7: smb7(); goto lab_end;
lab_0xf8: sed(); goto lab_end;
lab_0xf9: sbc_absy(); goto lab_end;
lab_0xfa: plx(); goto lab_end;
lab_0xfb: handle_bp15(); goto lab_end;
lab_0xfc: handle_bios(); goto lab_end;
lab_0xfd: sbc_absx(); goto lab_end;
lab_0xfe: inc_absx(); goto lab_end;
lab_0xff: bbs7(); goto lab_end;
